## config/Kconfig
```kconfig
# config/Kconfig

menu "Prospector Config"

source "prospector_scanner.conf"

endmenu
```

## config/west.yml
```yaml
manifest:
  remotes:
    - name: zmkfirmware
      url-base: https://github.com/zmkfirmware
    - name: prospector
      url-base: https://github.com/t-ogura
    - name: englmaxi
      url-base: https://github.com/englmaxi

  projects:
    - name: zmk
      remote: zmkfirmware
      revision: main

    # ⚠️ 一時的にカスタムモジュールをコメントアウト ⚠️
    # ビルドが成功することを確認した後、これらを戻します。
    # - name: prospector-zmk-module
    #   remote: prospector
    #   revision: v1.1.1
    #   path: modules/prospector-zmk-module

    # - name: zmk-dongle-display
    #   remote: englmaxi
    #   revision: main
    #   path: modules/zmk-dongle-display

  self:
    path: config
```
