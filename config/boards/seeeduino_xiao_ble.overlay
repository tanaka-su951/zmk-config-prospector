// config/prospector_scanner.overlay

// 🚨 最終修正: DTC_INCLUDE_DIRSがdtsフォルダを指すため、ファイル名のみを指定
#include <st7789v.dtsi> 
 
/ {
   chosen {
      // プライマリディスプレイとして st7789v を参照
      zephyr,display = &st7789v;
   };
};
