// config/prospector_scanner.overlay (最もクリーンでシンプルなマトリクス定義)

/ {
    chosen {
        zmk,kscan = &kscan0;
    };

    kscan0: kscan {
        compatible = "zmk,kscan-gpio-matrix";
        diode-direction = "col2row"; // または row2col
        
        // 1列1行のダミーマトリクスを定義し、ビルドを通すことが目的
        row-gpios = <&gpio0 2 GPIO_PULL_DOWN>;
        col-gpios = <&gpio0 3 GPIO_PULL_UP>;

        // スキャンインターバルを設定
        poll-interval = <5>; // 5ms
        
        status = "okay";
    };

    // デフォルトのLEDなどは削除してもよいが、今回は最小構成で残す
};
